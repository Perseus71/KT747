## fs/exfat/Kconfig
```kconfig
config EXFAT_FS
	tristate
	default n
	select NLS
	select NLS_UTF8
	help
	If you want to use the exFAT file systems, then you must say Y or M here 
	to inlucde exFAT support.

config EXFAT_DEFAULT_CODEPAGE
	int "Default codepage for exFAT"
	depends on EXFAT_FS
	default 437
	help
	  This option should be set to the codepage of your exFAT filesystems.

config EXFAT_DEFAULT_IOCHARSET
	string "Default iocharset for exFAT"
	depends on EXFAT_FS
	default "utf8"
	help
	  Set this to the default input/output character set you'd like exFAT to use.
```
